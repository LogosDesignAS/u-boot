## board/logos/ni8/Kconfig
```kconfig
if TARGET_LOGOSNI8

config SYS_BOARD
	default "ni8"

config SYS_VENDOR
	default "logos"

config SYS_CONFIG_NAME
	default "logosni8"

endif
```

## board/logos/nicore8/Kconfig
```kconfig
if TARGET_LOGOSNICORE8

config SYS_BOARD
	default "nicore8"

config SYS_VENDOR
	default "logos"

config SYS_CONFIG_NAME
	default "logosnicore8"

endif

if TARGET_LOGOSNICORE8DEV

config SYS_BOARD
	default "nicore8"

config SYS_VENDOR
	default "logos"

config SYS_CONFIG_NAME
	default "logosnicore8"

endif
```

## configs/logosni8_defconfig
```kconfig
# Architecture and target configs
CONFIG_TARGET_LOGOSNI8=y
CONFIG_ARCH_MX6=y
CONFIG_MX6S=y
CONFIG_ARM=y
CONFIG_ARCH_MISC_INIT=y

# Set default Device Tree - TODO: Remember to update device tree - might not be possible while using JTAG - try with flash
#CONFIG_DEFAULT_DEVICE_TREE="imx6dl-nitrogen6x"
CONFIG_DEFAULT_DEVICE_TREE="imx6dl-nicore8"

# Configurations of device tree - Make it possible to do runtime configuration via the device tree (uncomment to use device tree)
CONFIG_OF_CONTROL=y
CONFIG_OF_EMBED=y

# Memory and address settings
# CONFIG_SYS_MEMTEST_START=0x10000000 - we have disabled memtest
# CONFIG_SYS_MEMTEST_END=0x10010000 - we have disabled memtest
CONFIG_SYS_TEXT_BASE=0x17800000
CONFIG_SYS_MALLOC_F_LEN=0x4000

# Aligned with the maximum supported erase block for SPI flash = 4 KiB
# Was 0x2000 for NOR
#CONFIG_ENV_SECT_SIZE=0x10000
# Offset of ENV partition in SPI flash
# Was 0xC0000 for NOR
#CONFIG_ENV_OFFSET=
# Was 0x2000 for NOR
#CONFIG_ENV_SIZE=

CONFIG_NR_DRAM_BANKS=1

# Driver models - enabled
CONFIG_DM=y

# Console Settings
CONFIG_SYS_CONSOLE_OVERWRITE_ROUTINE=y

# Enabled the Board_Early_init function to set up GPIO and UART for early testing
CONFIG_BOARD_EARLY_INIT_R=y
# enable board late init
CONFIG_BOARD_LATE_INIT=y

# GPIO Config
CONFIG_CMD_GPIO=y
CONFIG_DM_GPIO=y

# UART Config
CONFIG_MXC_UART=y
#CONFIG_DEBUG_UART

# Network Drivers (Can't be removed for now)
# Allows 802.3(clause 22) MII Management functions interface access
CONFIG_CMD_MII=y
# Enable support of the Media-Independent Interface (MII)
# Enable the support of the Reduced Gigabit Media-Independent
CONFIG_RGMII=y
CONFIG_MII=y

# Add startup scripts before boot in misc_init_r()
CONFIG_MISC_INIT_R=y

# Additional Options
CONFIG_SYS_EXTRA_OPTIONS="IMX_CONFIG=board/logos/ni8/logosni8.cfg,DDR_MB=512"

# This define is used to suppress the output on the UART - "IN: serial, Out: serial, ERR: serial"
CONFIG_SYS_CONSOLE_INFO_QUIET=y

# Configure Memory Technology Devices
CONFIG_MTD=y

# Enable support for parallel NOR flash
#CONFIG_MTD_NOR_FLASH=y

# SPI Configs
CONFIG_SPI=y
CONFIG_MXC_SPI=y
# Winbond W25Q32JW Serial NOR SPI flash (SPI1/CS0)
CONFIG_SPI_FLASH_WINBOND=y
# CONFIG_SYS_USE_SPIFLASH=y - Remove
#CONFIG_SPI_BOOT=y
#CONFIG_QSPI_BOOT=y
CONFIG_SF_DEFAULT_BUS=0
CONFIG_SF_DEFAULT_CS=0
# IMX6 max 52 MHz / QSPI flash max 133 MHz
CONFIG_SF_DEFAULT_SPEED=52000000
#CONFIG_SF_DEFAULT_MODE=QSPI_MODE_24BIT
#CONFIG_ENV_IS_IN_SPI_FLASH=y
# Support Nitrogen SPI
CONFIG_SPI_FLASH_SST=y

# Enable Flattened Image Tree support
CONFIG_FIT

# Config eMMC
CONFIG_MMC=y
#CONFIG_GENERIC_MMC=y
#CONFIG_SYS_USE_MMC=y
#CONFIG_SUPPORT_EMMC_BOOT=y
#CONFIG_GENERIC_MMC=y
#CONFIG_EMMC_BOOT=y

# Config EPPROM
CONFIG_CMD_EEPROM

# I2C Configs
CONFIG_CMD_I2C=y
CONFIG_I2C_EEPROM=y
CONFIG_SYS_I2C_IMX_LPI2C=y

# HDMI Configs
CONFIG_CMD_HDMIDETECT=y

# Boot Configs
CONFIG_SUPPORT_RAW_INITRD=y
CONFIG_USE_PREBOOT=y
CONFIG_BOOTDELAY=10

# Enable the hush shell, if, then, else logic in scripts
CONFIG_HUSH_PARSER=y

# Read and display information about the partition table on various media.
CONFIG_CMD_PART=y

#CONFIG_NETCONSOLE=y - REMOVE we dont need to change stdin/out from serial to network

# Freescale/NXP i.MX uSDHC/eSDHC controller support
CONFIG_FSL_USDHC=y
CONFIG_FSL_ESDHC_IMX=y

# SPL Configs
#CONFIG_SPL_TEXT_BASE=0x00908000
#CONFIG_SPL_MMC_SUPPORT=y
#CONFIG_SPL_SERIAL_SUPPORT=y
#CONFIG_CMD_SPL=Y
#CONFIG_SPL_SIZE_LIMIT=0x20000
#CONFIG_SPL=y
#CONFIG_SPL_BUILD=y
#CONFIG_SPL_GPIO_SUPPORT=y
#CONFIG_SPL_LIBCOMMON_SUPPORT=y
#CONFIG_SPL_LIBGENERIC_SUPPORT=y
#CONFIG_SPL_DMA=y
#CONFIG_SPL_I2C_SUPPORT=y
#CONFIG_SPL_USB_HOST_SUPPORT=y
#CONFIG_SPL_USB_GADGET=y
#CONFIG_SPL_USB_SDP_SUPPORT=y

# Needed when booting the OS
#CONFIG_SPL_OS_BOOT=Y


##############################################################################
# ------------------ Configs undefined for early testing ------------------- #
##############################################################################

# I2C Configs
#CONFIG_I2C0_ENABLE=y
#CONFIG_I2C1_ENABLE=y
#CONFIG_I2C2_ENABLE=y
#CONFIG_SUNXI=y
#CONFIG_DM_I2C=y
#CONFIG_DM_I2C_COMPAT=y
#CONFIG_SYS_I2C_MXC=y

# Commands
# Enable Caches for optimised bootup speed
CONFIG_CMD_CACHE=y
CONFIG_CMD_FS_GENERIC=y
#CONFIG_CMD_EXT2=y
CONFIG_CMD_EXT4=y
CONFIG_CMD_EXT4_WRITE=y
CONFIG_CMD_FAT=y
CONFIG_CMD_FAT_WRITE=y
CONFIG_CMD_BOOTZ=y
CONFIG_CMD_DHCP=y
CONFIG_CMD_TIME=y
CONFIG_CMD_PING=y
CONFIG_CMD_BMP=y
CONFIG_CMD_MMC=y
CONFIG_CMD_SF=y
CONFIG_CMD_SF_TEST=y
CONFIG_CMD_SPI=y
CONFIG_CMD_BMODE=y
CONFIG_CMD_UNZIP=y
# Extra Network Commands
CONFIG_CMD_ECHO=y
CONFIG_CMD_DNS=y
CONFIG_CMD_LINK_LOCAL=y
CONFIG_CMD_PCAP=y

# Video and Screen Configs
CONFIG_SYS_WHITE_ON_BLACK=y
CONFIG_VIDEO_BMP_GZIP=y
CONFIG_VIDEO_BMP_RLE8=y
CONFIG_BMP_16BPP=y
CONFIG_VIDEO_IPUV3=y
CONFIG_VIDEO=y

# TODO: This needs to be enabled for the HDMI to work - depends on the device tree
CONFIG_SPLASH_SCREEN=y
CONFIG_SPLASH_SCREEN_ALIGN=y

# USB Configs
#CONFIG_SYS_USB_EVENT_POLL_VIA_CONTROL_EP=y
#CONFIG_USB_FUNCTION_FASTBOOT=y
#CONFIG_USB_KEYBOARD=y
#CONFIG_USB_ETH_CDC=y
#CONFIG_USB_ETHER=y

#CONFIG_USB_EHCI_HCD=y
#CONFIG_USB_EHCI_MX6=y
#CONFIG_USB_UHCI_HCD=y
#CONFIG_USB_OHCI_HCD=y

#CONFIG_CMD_USB=y
#CONFIG_USB=y
#CONFIG_USB_UHCI=y
#CONFIG_USB_STORAGE
#CONFIG_CMD_USB_MASS_STORAGE=y
#CONFIG_USB_MASS_STORAGE=y

# Usb gadgets
#CONFIG_USB_GADGET_MANUFACTURER="Boundary"
#CONFIG_USB_GADGET_PRODUCT_NUM=0xa4a5
#CONFIG_USB_GADGET_VENDOR_NUM=0x0525
#CONFIG_USB_GADGET=y
#CONFIG_USB_GADGET_DOWNLOAD=n


# The Device Firmware Upgrade (DFU) allows to download and upload firmware to/from U-Boot connected over USB.
CONFIG_CI_UDC=y

# PHY Configs
CONFIG_PHYLIB=y
CONFIG_PHY_ATHEROS=y
# Random MAC ADDR - to be removed
CONFIG_NET_RANDOM_ETHADDR=y
# Number of Arp Retries
CONFIG_NET_RETRY_COUNT=0x05

# Driver models - (DM)'s
CONFIG_DM_VIDEO=y
CONFIG_DM_USB=y
CONFIG_DM_MMC=y
CONFIG_DM_ETH=y
CONFIG_DM_SPI=y
CONFIG_DM_SPI_FLASH=y

# Config Advanced Host Controller Interface for the SataDriver
# CONFIG_AHCI=y - REMOVE no sata

# Other Configs
CONFIG_FASTBOOT_BUF_ADDR=0x12000000
#CONFIG_SYS_RELOC_GD_ENV_ADDR=y
#CONFIG_CMD_FLASH is not set
#CONFIG_ENV_OVERWRITE=y
#CONFIG_BOUNCE_BUFFER=y

# Lib for passing the device tree to the Kernel
CONFIG_OF_LIBFDT_OVERLAY=y
```

## configs/logosnicore8_defconfig
```kconfig
# Architecture and target configs
CONFIG_TARGET_LOGOSNICORE8=y
CONFIG_ARCH_MX6=y
CONFIG_MX6S=y
CONFIG_ARM=y
CONFIG_ARCH_MISC_INIT=y

CONFIG_VERSION_VARIABLE=y

# Memory and address settings
CONFIG_SYS_TEXT_BASE=0x17800000
CONFIG_SYS_MALLOC_F_LEN=0x4000
CONFIG_NR_DRAM_BANKS=1

# Enabled the board_Early_init function to set up GPIO and UART for early testing
CONFIG_BOARD_EARLY_INIT_R=y
# enable board late init
CONFIG_BOARD_LATE_INIT=y

# Enable LTO - enabled for release - removes debug functionality
CONFIG_LTO=y
CONFIG_OF_EMBED=n

# Support fit image
CONFIG_LOAD_FIT=y

# Boot from eMMC Card
CONFIG_SUPPORT_EMMC_BOOT=y

# Block Devices
CONFIG_BLK=y

# Environment Support
# Don't allow the -f switch to env set override variable access flags.
CONFIG_ENV_ACCESS_IGNORE_FORCE=y
# If defined, only environment variables which explicitly set the 'w' writeable flag can be written and
# modified at runtime. No variables can be otherwise created, written or imported into the environment.
CONFIG_ENV_WRITEABLE_LIST=y
# If defined, the environment hash table is only ever appended with new data, but the existing hash
# table can never be dropped and reloaded with newly imported data. This may be used in combination
# with static flags to e.g. to protect variables which must not be modified.
CONFIG_ENV_APPEND=y
CONFIG_ENV_IS_NOWHERE=y

CONFIG_ENV_IS_IN_MMC=y
CONFIG_SYS_REDUNDAND_ENVIRONMENT=y
CONFIG_SYS_MMC_ENV_DEV=0
# Place environment at specific offset at the beginning of user partition.
CONFIG_SYS_MMC_ENV_PART=0
# User environment, two 32 KB areas for redundancy.
CONFIG_ENV_SIZE=0x8000
CONFIG_ENV_OFFSET=0x2000
CONFIG_ENV_OFFSET_REDUND=0xA000
CONFIG_SYS_RELOC_GD_ENV_ADDR=y
CONFIG_ENV_VARS_UBOOT_RUNTIME_CONFIG=y

# Add startup scripts before boot in misc_init_r()
CONFIG_MISC_INIT_R=y

# Additional Options
CONFIG_SYS_EXTRA_OPTIONS="DDR_MB=512"

# Add configuration file for nicore8
CONFIG_IMX_CONFIG="board/logos/nicore8/nicore8.cfg"

# Config eMMC
CONFIG_MMC=y

# Boot options
# set to -2 to autoboot with no delay and not check for abort
CONFIG_BOOTDELAY=-2
CONFIG_BOOTCOUNT_LIMIT=n

# Watchdog Configs
CONFIG_WATCHDOG_TIMEOUT_MSECS=60000
CONFIG_IMX_WATCHDOG=y

# HAB - High Assurance Boot
CONFIG_IMX_HAB=y
CONFIG_SECURE_BOOT=y

# Enable the hush shell, if, then, else logic in scripts
CONFIG_HUSH_PARSER=y

# Freescale/NXP i.MX uSDHC/eSDHC controller support
CONFIG_FSL_USDHC=y
CONFIG_FSL_ESDHC_IMX=y

# Configurations of device tree - Make it possible to do runtime configuration via the device tree (uncomment to use device tree)
CONFIG_OF_CONTROL=y

# Enable Flattened Image Tree support
CONFIG_FIT=y

# Set default Device Tree
CONFIG_DEFAULT_DEVICE_TREE="imx6dl-nicore8"

# Driver models - (DM)'s
CONFIG_DM=y
CONFIG_DM_GPIO=y
CONFIG_DM_MMC=y
CONFIG_DM_I2C=y
CONFIG_DM_SERIAL=y
# DM Watchdog support
CONFIG_WDT=y

# Commands
CONFIG_CMD_MMC=y

# Read and display information about the partition table on various media.
CONFIG_CMD_PART=y
CONFIG_CMD_FS_GENERIC=y
CONFIG_CMD_FAT=y
CONFIG_CMD_BMODE=y
CONFIG_CMD_ECHO=y

# Serial Available
CONFIG_SERIAL_PRESENT=y
CONFIG_MXC_UART=y

# Silence the Console
CONFIG_SILENT_CONSOLE=y
CONFIG_SILENT_U_BOOT_ONLY=y
CONFIG_SILENT_CONSOLE_UPDATE_ON_SET=y

# OP-TEE Configurations
CONFIG_TEE=y
CONFIG_OPTEE=y
CONFIG_OPTEE_IMAGE=y
CONFIG_SUPPORT_EMMC_RPMB=y
CONFIG_BOOTM_OPTEE=y
CONFIG_OPTEE_LIB=y

# OP-TEE load address
CONFIG_OPTEE_LOAD_ADDR=0x2E000000
CONFIG_OPTEE_TZDRAM_SIZE=0x01e00000
CONFIG_OPTEE_TZDRAM_BASE=0x2E000000
CONFIG_OF_LIBFDT=y

###############################################################################################
## -------------------- Undefine unneeded Settings in this section --------------------------##
###############################################################################################

## Remove Unneeded Configs
CONFIG_CMD_BOOTEFI=n
CONFIG_CMD_BOOTEFI_HELLO_COMPILE=n
CONFIG_CMD_ELF=n
CONFIG_CMD_FDT=n

# The Command Line interface is required to run scripts.
CONFIG_CMDLINE=y
CONFIG_CMDLINE_EDITING=n

## Unneedded Network Commands
CONFIG_NET=n
CONFIG_CMD_NET=n
CONFIG_NETDEVICES=n
CONFIG_CMD_BOOTP=n
CONFIG_BOOTP_BOOTPATH=n
CONFIG_BOOTP_DNS=n
CONFIG_BOOTP_GATEWAY=n
CONFIG_BOOTP_HOSTNAME=n
CONFIG_BOOTP_SUBNETMASK=n
CONFIG_CMD_TFTPBOOT=n
CONFIG_NET_TFTP_VARS=n
CONFIG_CMD_NFS=n
CONFIG_CMD_BDI=n
CONFIG_CMD_CONSOLE=n
CONFIG_FEC_MXC=n

# Unneeded Boot Commands
CONFIG_CMD_BOOTD=n
CONFIG_BOOTM_NETBSD=n
CONFIG_BOOTM_PLAN9=n
CONFIG_BOOTM_RTEMS=n
CONFIG_BOOTM_VXWORKS=n
CONFIG_CMD_IMI=n
CONFIG_CMD_XIMG=n
CONFIG_CMD_RANDOM=n
CONFIG_CMD_SLEEP=n

# Disable Graphics Support
CONFIG_DM_VIDEO=n
CONFIG_BACKLIGHT=n
CONFIG_CMD_VIDCONSOLE=n
CONFIG_VIDEO_BPP8=n
CONFIG_VIDEO_BPP16=n
CONFIG_VIDEO_BPP32=n
CONFIG_VIDEO_ANSI=n
CONFIG_CONSOLE_NORMAL=n
CONFIG_PANEL=n
CONFIG_SIMPLE_PANEL=n

# Disable EEPROM
CONFIG_CMD_EEPROM=n

# Disable Console
CONFIG_REQUIRE_SERIAL_CONSOLE=y
CONFIG_SPECIFY_CONSOLE_INDEX=y
CONFIG_SYS_CONSOLE_INFO_QUIET=y
CONFIG_DISPLAY_CPUINFO=n
CONFIG_DISPLAY_BOARDINFO=n

# Disable CMD
CONFIG_AUTO_COMPLETE=n
CONFIG_SYS_LONGHELP=n
CONFIG_SYS_XTRACE=n
CONFIG_CMD_DEKBLOB=n

# Disable the Hash CMD
CONFIG_CMD_HASH=n

# Disable Compression Support
CONFIG_GZIP=n
CONFIG_ZLIB=n

# Disable Printf
CONFIG_PRINTF=n
CONFIG_SPRINTF=n
```
