// SPDX-License-Identifier: GPL-2.0+
//
// Copyright 2013-2019 Boundary Devices, Inc.
// Copyright 2012 Freescale Semiconductor, Inc.
// Copyright 2011 Linaro Ltd.
// Copyright 2021 Logos Payment Solutions A/S.

/dts-v1/;

#include "imx6dl.dtsi"
//#include "imx6qdl-nicore8.dtsi"

/ {
	model = "Logos NiCore8 board";
	compatible = "logos,imx6dl-nicore8", "fsl,imx6dl";
};

&iomuxc {
pinctrl_uart4: uart4grp {
fsl,pins = <
MX6QDL_PAD_CSI0_DAT12__UART4_RX_DATA 0x1b0b1
MX6QDL_PAD_CSI0_DAT13__UART4_TX_DATA 0x1b0b1
MX6QDL_PAD_CSI0_DAT17__UART4_CTS_B 0x1b0b1
MX6QDL_PAD_CSI0_DAT16__UART4_RTS_B 0x1b0b1
>;
};
};

&uart4 {
pinctrl-names = "default";
pinctrl-0 = <&pinctrl_uart4>;
uart-has-rtscts;
status = "okay";
};